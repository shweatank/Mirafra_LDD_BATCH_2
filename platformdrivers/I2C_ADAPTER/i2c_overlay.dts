/dts-v1/;
/plugin/;

/ {
    compatible = "brcm,bcm2711";

    fragment@0 {
        target = <&i2c1>;
        __overlay__ {
            compatible = "gki2c,bcm-i2c";
            status = "okay";
        };
    };
};

