/dts-v1/;
/plugin/;

/ {
    compatible = "brcm,bcm2711";

    fragment@0 {
        target-path = "/";
        __overlay__ {
            leds_node {
                compatible = "techdhaba,multi-led-blink";
                status = "okay";
                led-gpios = <&gpio 21 0>, <&gpio 20 0>, <&gpio 16 0>;
                label = "multi_led_driver";
            };
        };
    };
};
